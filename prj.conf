## prj.conf
```kconfig
#
# Copyright (c) 2019 Nordic Semiconductor ASA
#
# SPDX-License-Identifier: LicenseRef-Nordic-5-Clause
#
CONFIG_NCS_SAMPLES_DEFAULTS=y

# Deferred logging helps improve LPN power consumption
# when friendship is established.
CONFIG_LOG_MODE_DEFERRED=y

# General configuration
CONFIG_NCS_APPLICATION_BOOT_BANNER_STRING="Mesh Light"
CONFIG_SYSTEM_WORKQUEUE_STACK_SIZE=3072
CONFIG_FLASH=y
CONFIG_FLASH_MAP=y
CONFIG_NVS=y
CONFIG_SETTINGS=y
CONFIG_NVS_LOOKUP_CACHE=y
CONFIG_SETTINGS_NVS_NAME_CACHE=y
CONFIG_HWINFO=y
CONFIG_DK_LIBRARY=y
CONFIG_PM_PARTITION_SIZE_SETTINGS_STORAGE=0x8000
CONFIG_SOC_FLASH_NRF_PARTIAL_ERASE=y

# Bluetooth configuration
CONFIG_BT=y
CONFIG_BT_DEVICE_NAME="Thingy 53"
CONFIG_BT_L2CAP_TX_BUF_COUNT=8

CONFIG_BT_OBSERVER=y
CONFIG_BT_PERIPHERAL=y
CONFIG_BT_SETTINGS=y
# Increase RX stack size to avoid overflow during provisioning
CONFIG_BT_RX_STACK_SIZE=2700

# Disable unused Bluetooth features
CONFIG_BT_CTLR_LE_ENC=n
CONFIG_BT_PHY_UPDATE=n
CONFIG_BT_CTLR_CHAN_SEL_2=n
CONFIG_BT_CTLR_MIN_USED_CHAN=n
CONFIG_BT_CTLR_PRIVACY=n

# Bluetooth Mesh configuration
CONFIG_BT_MESH=y
CONFIG_BT_MESH_RELAY=y
CONFIG_BT_MESH_FRIEND=y
CONFIG_BT_MESH_TX_SEG_MAX=10
CONFIG_BT_MESH_PB_GATT=y
CONFIG_BT_MESH_GATT_PROXY=y
CONFIG_BT_MESH_PROXY_USE_DEVICE_NAME=y
CONFIG_BT_MESH_DK_PROV=y
CONFIG_BT_MESH_RPR_SRV=y
CONFIG_BT_MESH_MODEL_LOG_LEVEL_DBG=y
CONFIG_BT_MESH_RX_SEG_MSG_COUNT=4
CONFIG_BT_MESH_TX_SEG_MSG_COUNT=4


# Bluetooth Mesh models
CONFIG_BT_MESH_ONOFF_SRV=y
CONFIG_BT_MESH_LIGHTNESS_SRV=y
```

## src/main.c
```c
/*
 * Copyright (c) 2019 Nordic Semiconductor ASA
 *
 * SPDX-License-Identifier: LicenseRef-Nordic-5-Clause
 */

/** @file
 *  @brief Nordic mesh light sample
 */
#include <zephyr/bluetooth/bluetooth.h>
#include <zephyr/bluetooth/mesh.h>
#include <zephyr/kernel.h>
#include <bluetooth/mesh/models.h>
#include <bluetooth/mesh/dk_prov.h>
#include <dk_buttons_and_leds.h>
#include "model_handler.h"
#include "smp_bt.h"

/* Hold SW1 for this long to trigger a factory reset */
#define FACTORY_RESET_HOLD_MS 4000
#define FACTORY_RESET_BLINK_MS 200

static struct k_work_delayable factory_reset_work;
static struct k_work_delayable factory_reset_blink_work;
static int factory_reset_blink_count;

static void factory_reset_blink_handler(struct k_work *work)
{
	factory_reset_blink_count--;
	dk_set_leds(factory_reset_blink_count & 1 ? DK_ALL_LEDS_MSK : DK_NO_LEDS_MSK);
	if (factory_reset_blink_count > 0) {
		k_work_reschedule(&factory_reset_blink_work, K_MSEC(FACTORY_RESET_BLINK_MS));
	} else {
		dk_set_leds(DK_NO_LEDS_MSK);
		bt_mesh_reset();
		printk("Factory reset!\n");
	}
}

static void factory_reset_handler(struct k_work *work)
{
	/* Blink 3 times (6 toggles) to confirm, then reset */
	factory_reset_blink_count = 6;
	k_work_reschedule(&factory_reset_blink_work, K_NO_WAIT);
}

static void button_handler_cb(uint32_t button_state, uint32_t has_changed)
{
	if (!(has_changed & BIT(0))) {
		return;
	}

	if (button_state & BIT(0)) {
		/* Button pressed: start factory reset countdown */
		k_work_reschedule(&factory_reset_work, K_MSEC(FACTORY_RESET_HOLD_MS));
	} else {
		/* Button released: if countdown still pending it was a short press */
		if (k_work_delayable_is_pending(&factory_reset_work)) {
			k_work_cancel_delayable(&factory_reset_work);
			model_handler_led_toggle();
		}
	}
}

static void bt_ready(int err)
{
	if (err) {
		printk("Bluetooth init failed (err %d)\n", err);
		return;
	}

	printk("Bluetooth initialized\n");

	err = dk_leds_init();
	if (err) {
		printk("Initializing LEDs failed (err %d)\n", err);
		return;
	}

	k_work_init_delayable(&factory_reset_work, factory_reset_handler);
	k_work_init_delayable(&factory_reset_blink_work, factory_reset_blink_handler);

	err = dk_buttons_init(button_handler_cb);
	if (err) {
		printk("Initializing buttons failed (err %d)\n", err);
		return;
	}

	err = bt_mesh_init(bt_mesh_dk_prov_init(), model_handler_init());
	if (err) {
		printk("Initializing mesh failed (err %d)\n", err);
		return;
	}

	if (IS_ENABLED(CONFIG_SETTINGS)) {
		settings_load();
	}

	/* This will be a no-op if settings_load() loaded provisioning info */
	bt_mesh_prov_enable(BT_MESH_PROV_ADV | BT_MESH_PROV_GATT);

	printk("Mesh initialized\n");

	if (IS_ENABLED(CONFIG_MCUMGR_TRANSPORT_BT)) {
		err = smp_dfu_init();
		if (err) {
			printk("Unable to initialize DFU (err %d)\n", err);
		}
	}
}

int main(void)
{
	int err;

	printk("Initializing... (built " __DATE__ " " __TIME__ ")\n");
	bt_set_name("RPR Thingy 1 (Build " __DATE__ " " __TIME__ ")");

	err = bt_enable(bt_ready);
	if (err) {
		printk("Bluetooth init failed (err %d)\n", err);
	}

	return 0;
}
```

## include/model_handler.h
```c
/*
 * Copyright (c) 2019 Nordic Semiconductor ASA
 *
 * SPDX-License-Identifier: LicenseRef-Nordic-5-Clause
 */

/**
 * @file
 * @brief Model handler
 */

#ifndef MODEL_HANDLER_H__
#define MODEL_HANDLER_H__

#include <zephyr/bluetooth/mesh.h>

#ifdef __cplusplus
extern "C" {
#endif

const struct bt_mesh_comp *model_handler_init(void);
void model_handler_led_toggle(void);

#ifdef __cplusplus
}
#endif

#endif /* MODEL_HANDLER_H__ */
```

## src/model_handler.c
```c
/*
 * Copyright (c) 2019 Nordic Semiconductor ASA
 *
 * SPDX-License-Identifier: LicenseRef-Nordic-5-Clause
 */

#include <zephyr/bluetooth/bluetooth.h>
#include <zephyr/bluetooth/mesh/rpr_srv.h>
#include <bluetooth/mesh/models.h>
#include <dk_buttons_and_leds.h>
#include "model_handler.h"

static void lightness_set(struct bt_mesh_lightness_srv *srv,
			  struct bt_mesh_msg_ctx *ctx,
			  const struct bt_mesh_lightness_set *set,
			  struct bt_mesh_lightness_status *rsp);

static void lightness_get(struct bt_mesh_lightness_srv *srv,
			  struct bt_mesh_msg_ctx *ctx,
			  struct bt_mesh_lightness_status *rsp);

static const struct bt_mesh_lightness_srv_handlers lightness_handlers = {
	.light_set = lightness_set,
	.light_get = lightness_get,
};

static struct bt_mesh_lightness_srv lightness_srv =
	BT_MESH_LIGHTNESS_SRV_INIT(&lightness_handlers);

static uint16_t current_lightness;

static void lightness_set(struct bt_mesh_lightness_srv *srv,
			  struct bt_mesh_msg_ctx *ctx,
			  const struct bt_mesh_lightness_set *set,
			  struct bt_mesh_lightness_status *rsp)
{
	current_lightness = set->lvl;
	dk_set_led(0, current_lightness > 0);

	if (rsp) {
		rsp->current = current_lightness;
		rsp->target  = current_lightness;
		rsp->remaining_time = 0;
	}
}

static void lightness_get(struct bt_mesh_lightness_srv *srv,
			  struct bt_mesh_msg_ctx *ctx,
			  struct bt_mesh_lightness_status *rsp)
{
	rsp->current = current_lightness;
	rsp->target  = current_lightness;
	rsp->remaining_time = 0;
}

/* Set up a repeating delayed work to blink the DK's LEDs when attention is
 * requested.
 */
static struct k_work_delayable attention_blink_work;
static bool attention;

static void attention_blink(struct k_work *work)
{
	static int idx;
	const uint8_t pattern[] = {
#if DT_NODE_EXISTS(DT_ALIAS(led0))
		BIT(0),
#endif
#if DT_NODE_EXISTS(DT_ALIAS(led1))
		BIT(1),
#endif
#if DT_NODE_EXISTS(DT_ALIAS(led2))
		BIT(2),
#endif
#if DT_NODE_EXISTS(DT_ALIAS(led3))
		BIT(3),
#endif
	};

	if (attention) {
		dk_set_leds(pattern[idx++ % ARRAY_SIZE(pattern)]);
		k_work_reschedule(&attention_blink_work, K_MSEC(30));
	} else {
		dk_set_leds(DK_NO_LEDS_MSK);
	}
}

static void attention_on(const struct bt_mesh_model *mod)
{
	attention = true;
	k_work_reschedule(&attention_blink_work, K_NO_WAIT);
}

static void attention_off(const struct bt_mesh_model *mod)
{
	/* Will stop rescheduling blink timer */
	attention = false;
}

static const struct bt_mesh_health_srv_cb health_srv_cb = {
	.attn_on = attention_on,
	.attn_off = attention_off,
};

static struct bt_mesh_health_srv health_srv = {
	.cb = &health_srv_cb,
};

BT_MESH_HEALTH_PUB_DEFINE(health_pub, 0);

static struct bt_mesh_elem elements[] = {
	BT_MESH_ELEM(
		1, BT_MESH_MODEL_LIST(
			BT_MESH_MODEL_CFG_SRV,
			BT_MESH_MODEL_RPR_SRV,
			BT_MESH_MODEL_HEALTH_SRV(&health_srv, &health_pub),
			BT_MESH_MODEL_LIGHTNESS_SRV(&lightness_srv)),
		BT_MESH_MODEL_NONE),
};

static const struct bt_mesh_comp comp = {
	.cid = CONFIG_BT_COMPANY_ID,
	.elem = elements,
	.elem_count = ARRAY_SIZE(elements),
};

const struct bt_mesh_comp *model_handler_init(void)
{
	k_work_init_delayable(&attention_blink_work, attention_blink);
	return &comp;
}

void model_handler_led_toggle(void)
{
	uint16_t new_lvl = current_lightness > 0 ? 0 : UINT16_MAX;
	struct bt_mesh_lightness_set set = {
		.lvl = new_lvl,
	};
	struct bt_mesh_lightness_status status;

	lightness_set(&lightness_srv, NULL, &set, &status);
	bt_mesh_lightness_srv_pub(&lightness_srv, NULL, &status);
}
```
